## meta-mclayer/conf/layer.conf
```bitbake
# We have a conf and classes directory, add to BBPATH
BBPATH .= ":${LAYERDIR}"

# We have recipes-* directories, add to BBFILES
BBFILES += "${LAYERDIR}/recipes/*/*.bb \
            ${LAYERDIR}/recipes/*/*.bbappend \
            ${LAYERDIR}/recipes-*/*/*.bb \
            ${LAYERDIR}/recipes-*/*/*.bbappend"

#BBFILE_COLLECTIONS += "quectel-core"
BBFILE_COLLECTIONS += "mc-packages"
BBFILE_PATTERN_mc-packages = "^${LAYERDIR}/"
BBFILE_PRIORITY_mc-packages = "18"

#IMAGE_INSTALL += "mchello"

LAYERDEPENDS_mc-packages = "core"
LAYERSERIES_COMPAT_mc-packages = "dunfell"
```
